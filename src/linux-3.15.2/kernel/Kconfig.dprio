## src/linux-3.15.2/kernel/Kconfig.dprio
```kconfig
menuconfig DEFERRED_SETPRIO
	bool "Enable deferred setting of task priority"
	default n
	help
	  Enabling this option allows authorized applications to use
	  PR_SET_DEFERRED_SETPRIO request in prctl(2) system call.

	  Applications that change task priority with very high frequency can
	  benefit from using this facility as long as they are specifically
	  implemented to use prctl(PR_SET_DEFERRED_SETPRIO). If the system does
	  not intend to run such applications there is no benefit to using
	  this option.

	  The downside of selecting this option is a slightly increased latency
	  in task switching only in the case when a deferred set priority request
	  by a previous task is pending at task switch time. Added delay in task
	  context switch in this case is in the order of 1 usec (typical time for
	  executing deferred sched_setattr system call), which normally is not
	  significant, but may be a consideration in a system intended for hard
	  real-time use.

	  If unsure, say N.

if DEFERRED_SETPRIO

config PUT_TASK_TIMEBOUND
	bool "Deterministic task switch latency when deferred-set-task-priority is used"
	depends on DEFERRED_SETPRIO && RT_MUTEXES
	default n
	help
	  Enabling this option ensures deterministic time-bound task switch
	  latency when a deferred set task priority request is pending on a
	  task rescheduling and task switch, and the processing of this request
	  causes an adjustment of priority inheritance chain under very low
	  memory conditions (depleted atomic pool).

	  Select Y when building the kernel for hard real-time system requiring
	  the determinism in task switch latency. Select N for general-purpose
	  desktop or server system.

	  This option has memory cost of about 20-40 bytes per each running task
	  in the system.

config DEBUG_DEFERRED_SETPRIO
	bool "Enable debugging code for deferred-set-task-priority"
	depends on DEFERRED_SETPRIO
	default n
	help
	  Enable debugging code for DEFERRED_SETPRIO.

	  If unsure, say N.

config DEFERRED_SETPRIO_PRIVILEGED
	bool "Is deferred-set-task-priority a privileged operation"
	depends on DEFERRED_SETPRIO
	default y
	help
	  Define whether the deferred set task priority facility is accessible
	  only for tasks having CAP_DPRIO capability or the facility is
	  unprivileged and available to all users on the system. This option
	  defines the initial value of the setting at system startup time but
	  the setting can be altered later dynamically via
	  /proc/sys/kernel/dprio_privileged.

	  If unsure, say Y.

endif # DEFERRED_SETPRIO
```
